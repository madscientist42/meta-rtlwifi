## conf/layer.conf
```bitbake
# Append conf dir to BBPATH
BBPATH .= ":${LAYERDIR}"

# Append recipe dir to BBFILES
BBFILES += "${LAYERDIR}/recipes*/*/*.bb ${LAYERDIR}/recipes*/*/*.bbappend"

LAYERSERIES_COMPAT_rtlwifi = "kirkstone scarthgap"

BBFILE_COLLECTIONS += "rtlwifi"
BBFILE_PRIORITY_rtlwifi = "1"
BBFILE_PATTERN_rtlwifi = "${LAYERDIR}"
```
